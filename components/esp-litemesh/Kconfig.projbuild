## examples/4g_nic/sdkconfig.defaults
```kconfig
#
# Serial flasher config
#
CONFIG_ESPTOOLPY_FLASHSIZE_4MB=y

#
# Partition Table
#
CONFIG_PARTITION_TABLE_TWO_OTA=y

# Temporary Fix for Timer Overflows
CONFIG_FREERTOS_TIMER_TASK_STACK_DEPTH=4096

#
# ESP32-specific
#
CONFIG_MEMMAP_SMP=y
CONFIG_ESP_SYSTEM_EVENT_TASK_STACK_SIZE=4096

CONFIG_FREERTOS_UNICORE=n
CONFIG_FREERTOS_HZ=1000

CONFIG_ESP_INT_WDT=n
CONFIG_ESP_TASK_WDT_INIT=n

# LWIP
CONFIG_LWIP_L2_TO_L3_COPY=y
CONFIG_LWIP_IP_FORWARD=y
CONFIG_LWIP_IPV4_NAPT=y
CONFIG_LWIP_TCP_MSS=1460
CONFIG_LWIP_TCP_OVERSIZE_MSS=y

# Override some defaults to enable PPP
CONFIG_LWIP_PPP_SUPPORT=y
CONFIG_LWIP_PPP_PAP_SUPPORT=y
CONFIG_LWIP_TCPIP_TASK_STACK_SIZE=4096
# Do not enable IPV6 in dte<->dce link local
CONFIG_LWIP_PPP_ENABLE_IPV6=n
# Disable legacy API
CONFIG_MODEM_LEGACY_API=n

CONFIG_ETH_DMA_BUFFER_SIZE=1600

CONFIG_ETH_SPI_ETHERNET_DM9051=y
CONFIG_ETH_SPI_ETHERNET_KSZ8851SNL=y
CONFIG_ETH_SPI_ETHERNET_W5500=y

CONFIG_ESP_SYSTEM_MEMPROT_FEATURE=n

CONFIG_ESP_MAIN_TASK_STACK_SIZE=5120

# ESP-Iot-Bridge
CONFIG_BRIDGE_EXTERNAL_NETIF_STATION=n
CONFIG_BRIDGE_EXTERNAL_NETIF_MODEM=y
CONFIG_BRIDGE_DATA_FORWARDING_NETIF_SOFTAP=n
CONFIG_BRIDGE_DATA_FORWARDING_NETIF_ETHERNET=y
```

## examples/iperf/ethernet_wireless_nic/main/Kconfig.projbuild
```kconfig
menu "Bridge Misc Configuration"
    depends on BRIDGE_ENABLE

    menu "Network Distribution"
        depends on BRIDGE_EXTERNAL_NETIF_STATION

        config APP_BRIDGE_USE_WEB_SERVER
            bool "Wi-Fi Provisioning over Web Server"
            default y
            help
                Use Wi-Fi Provisioning over Web Server.

        config APP_BRIDGE_USE_WIFI_PROVISIONING_OVER_BLE
            bool "Wi-Fi Provisioning over Bluetooth Low Energy."
            depends on !IDF_TARGET_ESP32S2
            default n
            help
                Use Wi-Fi Provisioning over Bluetooth Low Energy.
    endmenu

    menu "Button Configuration"
        config APP_GPIO_BUTTON_SW1
            default 16 if IDF_TARGET_ESP32   || IDF_TARGET_ESP32H2
            default 38 if IDF_TARGET_ESP32S2 || IDF_TARGET_ESP32S3
            default 9
            int "GPIO button of switch"
            help
                Set the GPIO button of switch.
    endmenu
endmenu
```

## examples/iperf/ethernet_wireless_nic/sdkconfig.defaults.esp32s31
```kconfig
CONFIG_ETHERNET_INTERNAL_SUPPORT=y
CONFIG_ETHERNET_PHY_INTERFACE_DEFAULT=y
CONFIG_ETHERNET_PHY_GENERIC=y
CONFIG_ETHERNET_MDC_GPIO=5
CONFIG_ETHERNET_MDIO_GPIO=6
CONFIG_ETHERNET_PHY_RST_GPIO=7
CONFIG_ETHERNET_PHY_ADDR=-1
CONFIG_BRIDGE_ETH_PHY_YT8531_INIT=y

#
# TinyUSB Stack
#
CONFIG_TINYUSB_DEBUG_LEVEL=0

#
# Network driver (ECM/NCM/RNDIS)
#
CONFIG_TINYUSB_NET_MODE_NCM=y

CONFIG_TINYUSB_TASK_AFFINITY_CPU0=y
CONFIG_TINYUSB_INIT_IN_DEFAULT_TASK=y
```

## examples/rainmaker/led_light/main/Kconfig.projbuild
```kconfig
menu "RainMaker Led_Light Example"

    config EXAMPLE_BOARD_BUTTON_GPIO
        int "Boot Button GPIO"
        default 0 if !IDF_TARGET_ESP32C3
        default 9 if IDF_TARGET_ESP32C3
        help
            GPIO number on which the "Boot" button is connected. This is generally used
            by the application for custom operations like toggling states, resetting to defaults, etc.

    menu "ESPNOW Configuration"

        config ESPNOW_PMK
            string "ESPNOW primary master key"
            default "pmk1234567890123"
            help
                ESPNOW primary master for the example to use. The length of ESPNOW primary master must be 16 bytes.

    endmenu

endmenu
```

## examples/rainmaker/led_light/sdkconfig_defaults/sdkconfig.defaults.esp32
```kconfig
CONFIG_ESPTOOLPY_FLASHSIZE_4MB=y
CONFIG_LWIP_L2_TO_L3_COPY=y
CONFIG_LWIP_IP_FORWARD=y
CONFIG_LWIP_IPV4_NAPT=y
CONFIG_LWIP_TCP_MSS=624
CONFIG_LWIP_TCP_OVERSIZE_MSS=y

CONFIG_PARTITION_TABLE_CUSTOM=y
CONFIG_PARTITION_TABLE_CUSTOM_FILENAME="partition_table/partitions_esp32.csv"
CONFIG_PARTITION_TABLE_FILENAME="partition_table/partitions_esp32.csv"
CONFIG_PARTITION_TABLE_OFFSET=0x8000
CONFIG_PARTITION_TABLE_MD5=y

# mbedtls
CONFIG_MBEDTLS_DYNAMIC_BUFFER=y
CONFIG_MBEDTLS_DYNAMIC_FREE_PEER_CERT=y
CONFIG_MBEDTLS_DYNAMIC_FREE_CONFIG_DATA=y

# For BLE Provisioning using NimBLE stack (Not applicable for ESP32-S2)
CONFIG_BT_ENABLED=y
CONFIG_BTDM_CTRL_MODE_BLE_ONLY=y
CONFIG_BT_NIMBLE_ENABLED=y

# Temporary Fix for Timer Overflows
CONFIG_FREERTOS_TIMER_TASK_STACK_DEPTH=4096

# For additional security on reset to factory
CONFIG_ESP_RMAKER_USER_ID_CHECK=y

# ESP Wi-Fi Mesh Lite
CONFIG_MESH_LITE_ENABLE=y
CONFIG_BRIDGE_USE_WEB_SERVER=n
CONFIG_MESH_LITE_SOFTAP_SSID_END_WITH_THE_MAC=y
CONFIG_JOIN_MESH_WITHOUT_CONFIGURED_WIFI_INFO=n
```

## examples/rainmaker/led_light/sdkconfig_defaults/sdkconfig.defaults.esp32c3
```kconfig
CONFIG_ESPTOOLPY_FLASHSIZE_4MB=y
CONFIG_LWIP_ESP_LWIP_ASSERT=n
CONFIG_LWIP_L2_TO_L3_COPY=y
CONFIG_LWIP_IP_FORWARD=y
CONFIG_LWIP_IPV4_NAPT=y
CONFIG_LWIP_TCP_MSS=624
CONFIG_LWIP_TCP_OVERSIZE_MSS=y
CONFIG_LWIP_IPV6=n
CONFIG_LWIP_ICMP=n

CONFIG_PARTITION_TABLE_CUSTOM=y
CONFIG_PARTITION_TABLE_CUSTOM_FILENAME="partition_table/partitions_4MB_esp32c3.csv"
CONFIG_PARTITION_TABLE_FILENAME="partition_table/partitions_4MB_esp32c3.csv"
CONFIG_PARTITION_TABLE_OFFSET=0x5000
CONFIG_PARTITION_TABLE_MD5=y

# Bootloader config
CONFIG_BOOTLOADER_APP_ROLLBACK_ENABLE=y
CONFIG_BOOTLOADER_SKIP_VALIDATE_IN_DEEP_SLEEP=y
CONFIG_BOOTLOADER_SKIP_VALIDATE_ON_POWER_ON=y
CONFIG_BOOTLOADER_SKIP_VALIDATE_ALWAYS=y
CONFIG_BOOTLOADER_LOG_LEVEL_WARN=y

# mbedtls
CONFIG_MBEDTLS_DYNAMIC_BUFFER=y
CONFIG_MBEDTLS_DYNAMIC_FREE_PEER_CERT=y
CONFIG_MBEDTLS_DYNAMIC_FREE_CONFIG_DATA=y
CONFIG_MBEDTLS_SSL_PROTO_TLS1=n
CONFIG_MBEDTLS_SSL_PROTO_TLS1_1=n
CONFIG_MBEDTLS_TLS_CLIENT_ONLY=y

# For BLE Provisioning using NimBLE stack (Not applicable for ESP32-S2)
CONFIG_BT_ENABLED=y
CONFIG_BTDM_CTRL_MODE_BLE_ONLY=y
CONFIG_BT_NIMBLE_ENABLED=y
CONFIG_BT_NIMBLE_MAX_CONNECTIONS=5
CONFIG_BT_NIMBLE_ROLE_CENTRAL=n
CONFIG_BT_NIMBLE_ROLE_OBSERVER=n

# Temporary Fix for Timer Overflows
CONFIG_FREERTOS_TIMER_TASK_STACK_DEPTH=4096

# For additional security on reset to factory
CONFIG_ESP_RMAKER_USER_ID_CHECK=y
CONFIG_ESP_RMAKER_SELF_CLAIM=y

# ESP RainMaker App Wi-Fi Provisioning
CONFIG_APP_WIFI_PROV_SHOW_QR=n
CONFIG_APP_WIFI_PROV_TIMEOUT_PERIOD=3

# Log output
CONFIG_LOG_DEFAULT_LEVEL_WARN=y
CONFIG_LOG_COLORS=n

# Compiler options
CONFIG_COMPILER_OPTIMIZATION_SIZE=y
CONFIG_COMPILER_OPTIMIZATION_ASSERTIONS_SILENT=y

# Newlib
CONFIG_NEWLIB_NANO_FORMAT=y

# Virtual file system
CONFIG_VFS_SUPPORT_DIR=n
CONFIG_VFS_SUPPORT_SELECT=n
CONFIG_VFS_SUPPORT_TERMIOS=n

# ESP NETIF Adapter
CONFIG_ESP_NETIF_TCPIP_ADAPTER_COMPATIBLE_LAYER=n

# Common ESP-related
CONFIG_ESP_ERR_TO_NAME_LOOKUP=n

# ESP-MQTT Configurations
CONFIG_MQTT_TRANSPORT_WEBSOCKET=n

# Wi-Fi
CONFIG_ESP_WIFI_FTM_INITIATOR_SUPPORT=n
CONFIG_ESP_WIFI_FTM_RESPONDER_SUPPORT=n

# PHY
CONFIG_ESP_PHY_MAX_WIFI_TX_POWER=20

CONFIG_WS2812_LED_ENABLE=y

CONFIG_LITEMESH_ENABLE=y
CONFIG_BRIDGE_USE_WEB_SERVER=n
CONFIG_LITEMESH_SOFTAP_SSID_END_WITH_THE_MAC=y
CONFIG_JOIN_MESH_WITHOUT_CONFIGURED_WIFI_INFO=n
```

## examples/rainmaker/led_light/sdkconfig_defaults/sdkconfig.defaults.esp32s3
```kconfig
CONFIG_ESPTOOLPY_FLASHSIZE_4MB=y
CONFIG_LWIP_L2_TO_L3_COPY=y
CONFIG_LWIP_IP_FORWARD=y
CONFIG_LWIP_IPV4_NAPT=y
CONFIG_LWIP_TCP_MSS=624
CONFIG_LWIP_TCP_OVERSIZE_MSS=y

CONFIG_PARTITION_TABLE_CUSTOM=y
CONFIG_PARTITION_TABLE_CUSTOM_FILENAME="partition_table/partitions_esp32s3.csv"
CONFIG_PARTITION_TABLE_FILENAME="partition_table/partitions_esp32s3.csv"
CONFIG_PARTITION_TABLE_OFFSET=0x8000
CONFIG_PARTITION_TABLE_MD5=y

# ESP RainMaker Config
CONFIG_ESP_RMAKER_SELF_CLAIM=y
CONFIG_ESP_RMAKER_USER_ID_CHECK=y
CONFIG_ESP_RMAKER_OTA_AUTOFETCH=y
CONFIG_ESP_RMAKER_OTA_AUTOFETCH_PERIOD=6
CONFIG_ESP_RMAKER_USE_CERT_BUNDLE=n
CONFIG_ESP_RMAKER_MQTT_USE_CERT_BUNDLE=n

# mbedtls
CONFIG_MBEDTLS_DYNAMIC_BUFFER=y
CONFIG_MBEDTLS_DYNAMIC_FREE_PEER_CERT=y
CONFIG_MBEDTLS_DYNAMIC_FREE_CONFIG_DATA=y

# For BLE Provisioning using NimBLE stack (Not applicable for ESP32-S2)
CONFIG_BT_ENABLED=y
CONFIG_BTDM_CTRL_MODE_BLE_ONLY=y
CONFIG_BT_NIMBLE_ENABLED=y

# Temporary Fix for Timer Overflows
CONFIG_FREERTOS_TIMER_TASK_STACK_DEPTH=4096

# ESP Wi-Fi Mesh Lite
CONFIG_MESH_LITE_ENABLE=y
CONFIG_BRIDGE_USE_WEB_SERVER=n
CONFIG_MESH_LITE_SOFTAP_SSID_END_WITH_THE_MAC=y
CONFIG_JOIN_MESH_WITHOUT_CONFIGURED_WIFI_INFO=n
```

## examples/wifi_router/main/Kconfig.projbuild
```kconfig
menu "Bridge Misc Configuration"
    depends on BRIDGE_ENABLE

    menu "Network Distribution"
        depends on BRIDGE_EXTERNAL_NETIF_STATION

        config BRIDGE_USE_WEB_SERVER
            bool "Wi-Fi Provisioning over Web Server"
            default y
            help
                Use Wi-Fi Provisioning over Web Server.
                
        config BRIDGE_USE_WIFI_PROVISIONING_OVER_BLE
            bool "Wi-Fi Provisioning over Bluetooth Low Energy."
            depends on !IDF_TARGET_ESP32S2
            default n
            help
                Use Wi-Fi Provisioning over Bluetooth Low Energy.

        menu "Bridge Wi-Fi Provisioning Configuration"
            depends on BRIDGE_USE_WIFI_PROVISIONING_OVER_BLE

            choice BRIDGE_PROV_TRANSPORT
                bool "Provisioning Transport"
                default BRIDGE_PROV_TRANSPORT_BLE
                help
                    Wi-Fi provisioning component offers both, SoftAP and BLE transports. Choose any one.

                config BRIDGE_PROV_TRANSPORT_BLE
                    bool "BLE"
                    select BT_ENABLED
                    depends on !IDF_TARGET_ESP32S2
            endchoice

            choice BRIDGE_PROV_SECURITY_VERSION
                bool "Protocomm security version"
                default BRIDGE_PROV_SECURITY_VERSION_2
                help
                    Wi-Fi provisioning component offers 3 security versions.
                    The example offers a choice between security version 1 and 2.

                config BRIDGE_PROV_SECURITY_VERSION_1
                    bool "Security version 1"
                    select ESP_PROTOCOMM_SUPPORT_SECURITY_VERSION_1

                config BRIDGE_PROV_SECURITY_VERSION_2
                    bool "Security version 2"
                    select ESP_PROTOCOMM_SUPPORT_SECURITY_VERSION_2
            endchoice

            choice BRIDGE_PROV_MODE
                bool "Security version 2 mode"
                depends on BRIDGE_PROV_SECURITY_VERSION_2
                default BRIDGE_PROV_SEC2_DEV_MODE

                config BRIDGE_PROV_SEC2_DEV_MODE
                    bool "Security version 2 development mode"
                    depends on BRIDGE_PROV_SECURITY_VERSION_2
                    help
                        This enables the development mode for
                        security version 2.
                        Please note that this mode is NOT recommended for production purpose.

                config BRIDGE_PROV_SEC2_PROD_MODE
                    bool "Security version 2 production mode"
                    depends on BRIDGE_PROV_SECURITY_VERSION_2
                    help
                        This enables the production mode for
                        security version 2.
            endchoice

            config BRIDGE_PROV_TRANSPORT
                int
                default 1 if BRIDGE_PROV_TRANSPORT_BLE

            config BRIDGE_RESET_PROVISIONED
                bool
                default n
                prompt "Reset provisioned status of the device"
                help
                    This erases the NVS to reset provisioned status of the device on every reboot.
                    Provisioned status is determined by the Wi-Fi STA configuration, saved on the NVS.

            config BRIDGE_RESET_PROV_MGR_ON_FAILURE
                bool
                default y
                prompt "Reset provisioned credentials and state machine after session failure"
                help
                    Enable reseting provisioned credentials and state machine after session failure.
                    This will restart the provisioning service after retries are exhausted.

            config BRIDGE_PROV_MGR_MAX_RETRY_CNT
                int
                default 5
                prompt "Max retries before reseting provisioning state machine"
                depends on BRIDGE_RESET_PROV_MGR_ON_FAILURE
                help
                    Set the Maximum retry to avoid reconnecting to an inexistent AP or if credentials
                    are misconfigured. Provisioned credentials are erased and internal state machine
                    is reset after this threshold is reached.

            config BRIDGE_PROV_SHOW_QR
                bool "Show provisioning QR code"
                default y
                help
                    Show the QR code for provisioning.

            config BRIDGE_PROV_USING_BLUEDROID
                bool
                depends on (BT_BLUEDROID_ENABLED && (IDF_TARGET_ESP32C3 || IDF_TARGET_ESP32S3))
                select BT_BLE_42_FEATURES_SUPPORTED
                default y
                help
                    This enables BLE 4.2 features for Bluedroid.
        endmenu
    endmenu

    menu "Button Configuration"
        config GPIO_BUTTON_SW1
            default 16 if IDF_TARGET_ESP32   || IDF_TARGET_ESP32H2
            default 9  if IDF_TARGET_ESP32C3 || IDF_TARGET_ESP32C2
            default 38 if IDF_TARGET_ESP32S2 || IDF_TARGET_ESP32S3
            int "GPIO button of switch"
            help
                Set the GPIO button of switch.
    endmenu
endmenu
```

## examples/wifi_router/sdkconfig.defaults
```kconfig
#
# Serial flasher config
#
CONFIG_ESPTOOLPY_FLASHSIZE_4MB=y

#
# Partition Table
#
CONFIG_PARTITION_TABLE_CUSTOM=y
CONFIG_PARTITION_TABLE_CUSTOM_FILENAME="partitions.csv"
CONFIG_PARTITION_TABLE_FILENAME="partitions.csv"


# Temporary Fix for Timer Overflows
CONFIG_FREERTOS_TIMER_TASK_STACK_DEPTH=4096

#
# HTTP Server
#
CONFIG_HTTPD_MAX_REQ_HDR_LEN=1024

#
# ESP32-specific
#
CONFIG_ESP_SYSTEM_EVENT_TASK_STACK_SIZE=4096

CONFIG_COMPILER_OPTIMIZATION_SIZE=y

CONFIG_FREERTOS_UNICORE=n
CONFIG_FREERTOS_HZ=1000

CONFIG_ESP_INT_WDT=n
CONFIG_ESP_TASK_WDT_INIT=n

# LWIP
CONFIG_LWIP_L2_TO_L3_COPY=y
CONFIG_LWIP_IP_FORWARD=y
CONFIG_LWIP_IPV4_NAPT=y
CONFIG_LWIP_TCP_MSS=1460
CONFIG_LWIP_TCP_OVERSIZE_MSS=y

# Override some defaults to enable PPP
CONFIG_LWIP_PPP_SUPPORT=y
CONFIG_LWIP_PPP_PAP_SUPPORT=y
CONFIG_LWIP_TCPIP_TASK_STACK_SIZE=4096
# Do not enable IPV6 in dte<->dce link local
CONFIG_LWIP_PPP_ENABLE_IPV6=n

CONFIG_ETH_SPI_ETHERNET_DM9051=y
CONFIG_ETH_SPI_ETHERNET_KSZ8851SNL=y
CONFIG_ETH_SPI_ETHERNET_W5500=y
CONFIG_ETHERNET_DEFAULT_EVENT_HANDLER=n

# Override some defaults so BT stack is enabled and
CONFIG_BT_ENABLED=y
CONFIG_BT_NIMBLE_ENABLED=y
CONFIG_BT_NIMBLE_HOST_TASK_STACK_SIZE=5120

CONFIG_ESP_SYSTEM_MEMPROT_FEATURE=n

# ESP-Iot-Bridge
CONFIG_BRIDGE_SOFTAP_SSID_END_WITH_THE_MAC=y
```

## examples/wifi_router/sdkconfig.defaults.esp32
```kconfig
#
# ESP32-specific
#
CONFIG_ESP_COREDUMP_ENABLE=y
CONFIG_ESP_COREDUMP_ENABLE_TO_FLASH=y
CONFIG_ESP_DEFAULT_CPU_FREQ_MHZ_240=y
CONFIG_ESP_DEFAULT_CPU_FREQ_MHZ=240

CONFIG_APP_BRIDGE_USE_WIFI_PROVISIONING_OVER_BLE=y
```

## examples/wifi_router/sdkconfig.defaults.esp32s31
```kconfig
CONFIG_ETHERNET_SPI_SUPPORT=n
CONFIG_ETHERNET_INTERNAL_SUPPORT=n

#
# TinyUSB Stack
#
CONFIG_TINYUSB_DEBUG_LEVEL=0

#
# Network driver (ECM/NCM/RNDIS)
#
CONFIG_TINYUSB_NET_MODE_NCM=y

CONFIG_TINYUSB_TASK_AFFINITY_CPU0=y
CONFIG_TINYUSB_INIT_IN_DEFAULT_TASK=y
```

## examples/wired_nic/sdkconfig.defaults.esp32
```kconfig
#
# ESP32-specific
#
CONFIG_ESP_COREDUMP_ENABLE=y
CONFIG_ESP_COREDUMP_ENABLE_TO_FLASH=y
CONFIG_ESP_DEFAULT_CPU_FREQ_MHZ_240=y
CONFIG_ESP_DEFAULT_CPU_FREQ_MHZ=240
```
