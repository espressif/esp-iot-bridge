## components/esp-litemesh/Kconfig.projbuild
```kconfig
menu "Bridge LiteMesh Configuration"
    config LITEMESH_ENABLE
        bool "Enable LiteMesh"
        default n
        depends on BRIDGE_EXTERNAL_NETIF_STATION && BRIDGE_DATA_FORWARDING_NETIF_SOFTAP
        help
            Enable LiteMesh

    menu "LiteMesh info configuration"
        depends on LITEMESH_ENABLE
        config LITEMESH_VENDOR_ID_0
            int "VENDOR_ID_0 for LiteMesh"
            default 71

        config LITEMESH_VENDOR_ID_1
            int "VENDOR_ID_1 for LiteMesh"
            default 87

        config MESH_ID
            int "MESH_ID for LiteMesh"
            default 77

        config LITEMESH_SOFTAP_SSID
            string "SoftAP SSID"
            default "ESP_Bridge"
            help
                SSID of ESP-LiteMesh SoftAP.
                If enable LITEMESH_SOFTAP_SSID_END_WITH_THE_MAC, the maximum length of ssid is 25.

        config LITEMESH_SOFTAP_PASSWORD
            string "SoftAP Password"
            default "12345678"
            help
                password of ESP-LiteMesh SoftAP.

        config LITEMESH_SOFTAP_SSID_END_WITH_THE_MAC
            bool "SoftAP SSID ends with the MAC"
            default y
            help
                Add MAC to the end of SSID

        config LITEMESH_MAX_CONNECT_NUMBER
            int "Maximum number of connections per node"
            default 8
            range 1 10

        config LITEMESH_MAX_ROUTER_NUMBER
            int "Maximum number of trace router number"
            default 3
            range 1 5

        config LITEMESH_MAXIMUM_LEVEL_ALLOWED
            int "The maximum level allowed"
            default 10
            range 1 16

        config LITEMESH_NODE_INFO_REPORT
            bool "Enable node info report"
            default n
            help
                Sub-nodes report information regularly,
                and the root node collects and summarizes the mesh nodes information.

        config LITEMESH_REPORT_INTERVAL
            depends on LITEMESH_NODE_INFO_REPORT
            int "Report time interval(s)"
            default 300

        config JOIN_MESH_WITHOUT_CONFIGURED_WIFI_INFO
            bool "Join Mesh without configured with information"
            default y
            help
                Join the mesh network directly when starting up, regardless of whether Wi-Fi information is configured or not.
                If disabled, it will only join the mesh network after configuring Wi-Fi information.

        config JOIN_MESH_IGNORE_ROUTER_STATUS
            bool "Join Mesh no matter whether the node is connected to router"
            default n
            help
                If enabled, it will join Mesh no matter whether the node is connected to router
    endmenu
endmenu
```

## components/esp_mesh_lite/Kconfig.projbuild
```kconfig
menu "ESP Wi-Fi Mesh Lite"
    config MESH_LITE_ENABLE
        bool "Enable Mesh-Lite"
        default n
        depends on BRIDGE_EXTERNAL_NETIF_STATION && BRIDGE_DATA_FORWARDING_NETIF_SOFTAP
        help
            Enable Mesh-Lite

    menu "Mesh-Lite info configuration"
        depends on MESH_LITE_ENABLE
        config MESH_LITE_VENDOR_ID_0
            int "VENDOR_ID_0 for Mesh-Lite"
            default 71

        config MESH_LITE_VENDOR_ID_1
            int "VENDOR_ID_1 for Mesh-Lite"
            default 87

        config MESH_LITE_ID
            int "MESH_ID for Mesh-Lite"
            default 77

        config MESH_LITE_SOFTAP_SSID
            string "SoftAP SSID"
            default "ESP_Bridge"
            help
                SSID of ESP-Mesh-Lite SoftAP.
                If enable MESH_LITE_SOFTAP_SSID_END_WITH_THE_MAC, the maximum length of ssid is 25.

        config MESH_LITE_SOFTAP_PASSWORD
            string "SoftAP Password"
            default "12345678"
            help
                password of ESP-Mesh-Lite SoftAP.

        config MESH_LITE_SOFTAP_SSID_END_WITH_THE_MAC
            bool "SoftAP SSID ends with the MAC"
            default y
            help
                Add MAC to the end of SSID

        config MESH_LITE_MAX_CONNECT_NUMBER
            int "Maximum number of connections per node"
            default 8
            range 1 10

        config MESH_LITE_MAX_ROUTER_NUMBER
            int "Maximum number of trace router number"
            default 3
            range 1 5

        config MESH_LITE_MAXIMUM_LEVEL_ALLOWED
            int "The maximum level allowed"
            default 10
            range 1 16

        config MESH_LITE_NODE_INFO_REPORT
            bool "Enable node info report"
            default n
            help
                Sub-nodes report information regularly,
                and the root node collects and summarizes the mesh nodes information.

        config MESH_LITE_REPORT_INTERVAL
            depends on MESH_LITE_NODE_INFO_REPORT
            int "Report time interval(s)"
            default 300

        config JOIN_MESH_WITHOUT_CONFIGURED_WIFI_INFO
            bool "Join Mesh without configured with information"
            default y
            help
                Join the mesh network directly when starting up, regardless of whether Wi-Fi information is configured or not.
                If disabled, it will only join the mesh network after configuring Wi-Fi information.

        config JOIN_MESH_IGNORE_ROUTER_STATUS
            bool "Join Mesh no matter whether the node is connected to router"
            default n
            help
                If enabled, it will join Mesh no matter whether the node is connected to router
    endmenu
endmenu
```
