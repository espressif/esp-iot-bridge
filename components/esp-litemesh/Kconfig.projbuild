## components/iot_bridge/driver/Kconfig
```kconfig
menu "Bridge Driver Configuration"
    depends on BRIDGE_DATA_FORWARDING_NETIF_SPI || BRIDGE_DATA_FORWARDING_NETIF_SDIO

    menu "SPI Configuration"
        depends on BRIDGE_DATA_FORWARDING_NETIF_SPI

        config GPIO_MOSI
            int "GPIO pin for MOSI"
            default 13 if IDF_TARGET_ESP32
            default 11 if IDF_TARGET_ESP32S2 || IDF_TARGET_ESP32S3
            default  7
            help
                Select the GPIO pin for MOSI

        config GPIO_MISO
            int "GPIO pin for MISO"
            default 12 if IDF_TARGET_ESP32
            default 13 if IDF_TARGET_ESP32S2 || IDF_TARGET_ESP32S3
            default  2
            help
                Select the GPIO pin for MISO

        config GPIO_SCLK
            int "GPIO pin for SCLK"
            default 14 if IDF_TARGET_ESP32
            default 12 if IDF_TARGET_ESP32S2 || IDF_TARGET_ESP32S3
            default  6
            help
                Select the GPIO pin for SCLK

        config GPIO_CS
            int "GPIO pin for CS"
            default 15 if IDF_TARGET_ESP32
            default 10 if IDF_TARGET_ESP32S2 || IDF_TARGET_ESP32S3
            default 10
            help
                Select the GPIO pin for CS

        config ESP_SPI_GPIO_HANDSHAKE
            int "GPIO pin for handshake"
            default 3
            default 2
            help
                GPIO pin to use for handshake with other spi controller

        config ESP_SPI_GPIO_DATA_READY
            int "GPIO pin for data ready interrupt"
            default 4
            help
                GPIO pin for indicating host that SPI slave has data to be read by host

        config SPI_CLK_MHZ
            int "SPI clock speed (MHz)"
            default 10 if IDF_TARGET_ESP32
            default 30
            help
                Set the clock speed (MHz) of SPI interface.

        config ESP_SPI_TX_Q_SIZE
            int "ESP to Host SPI queue size"
            default 10 if IDF_TARGET_ESP32
            default 20
            help
                Smaller Tx queue sizes will reduce data throughput rates(ESP == SPI ==> Host)

        config ESP_SPI_RX_Q_SIZE
            int "Host to ESP SPI queue size"
            default 10 if IDF_TARGET_ESP32
            default 20
            help
                Smaller Rx queue sizes will reduce data throughput rates(ESP <== SPI == Host)
    endmenu

    menu "Enable Debug logs"
        config ESP_SERIAL_DEBUG
            bool "Debug Serial driver data path"
            default 0
            help
                Enable/disable debug prints in serial driver data path

        config ESP_WLAN_DEBUG
            bool "Debug Wlan driver data path"
            default 0
            help
                Enable/disable debug prints in wlan driver data path

        config BRIDGE_BT_ENABLED
            bool "Enable Bluetooth driver"
            default 0
            help
                Enable/disable debug prints in Bluetooth driver data path

        config ESP_BT_DEBUG
            depends on BRIDGE_BT_ENABLED
            bool "Debug Bluetooth driver data path"
            default 0
            help
                Enable/disable debug prints in Bluetooth driver data path
    endmenu
endmenu
```

## components/iot_bridge/drivers/Kconfig
```kconfig
menu "Bridge Driver Configuration"
    depends on BRIDGE_EXTERNAL_NETIF_SPI || BRIDGE_DATA_FORWARDING_NETIF_SPI || BRIDGE_EXTERNAL_NETIF_SDIO || BRIDGE_DATA_FORWARDING_NETIF_SDIO

    menu "SPI Configuration"
        depends on BRIDGE_EXTERNAL_NETIF_SPI || BRIDGE_DATA_FORWARDING_NETIF_SPI

        config GPIO_MOSI
            int "GPIO pin for MOSI"
            default 13 if IDF_TARGET_ESP32
            default 11 if IDF_TARGET_ESP32S2 || IDF_TARGET_ESP32S3
            default  7
            help
                Select the GPIO pin for MOSI

        config GPIO_MISO
            int "GPIO pin for MISO"
            default 12 if IDF_TARGET_ESP32
            default 13 if IDF_TARGET_ESP32S2 || IDF_TARGET_ESP32S3
            default  2
            help
                Select the GPIO pin for MISO

        config GPIO_SCLK
            int "GPIO pin for SCLK"
            default 14 if IDF_TARGET_ESP32
            default 12 if IDF_TARGET_ESP32S2 || IDF_TARGET_ESP32S3
            default  6
            help
                Select the GPIO pin for SCLK

        config GPIO_CS
            int "GPIO pin for CS"
            default 15 if IDF_TARGET_ESP32
            default 10
            help
                Select the GPIO pin for CS

        config ESP_SPI_GPIO_HANDSHAKE
            int "GPIO pin for handshake"
            default 3 if IDF_TARGET_ESP32C2 || IDF_TARGET_ESP32C3 || IDF_TARGET_ESP32C6
            default 2
            help
                GPIO pin to use for handshake with other spi controller

        config ESP_SPI_GPIO_DATA_READY
            int "GPIO pin for data ready interrupt"
            default 4
            help
                GPIO pin for indicating host that SPI slave has data to be read by host

        config SPI_CLK_MHZ
            int "SPI clock speed (MHz)"
            default 10 if IDF_TARGET_ESP32
            default 30
            help
                Set the clock speed (MHz) of SPI interface.

        config ESP_SPI_TX_Q_SIZE
            int "ESP to Host SPI queue size"
            default 10 if IDF_TARGET_ESP32
            default 20
            help
                Smaller Tx queue sizes will reduce data throughput rates(ESP == SPI ==> Host)

        config ESP_SPI_RX_Q_SIZE
            int "Host to ESP SPI queue size"
            default 10 if IDF_TARGET_ESP32
            default 20
            help
                Smaller Rx queue sizes will reduce data throughput rates(ESP <== SPI == Host)
    endmenu

    menu "SDIO Configuration"
        depends on BRIDGE_EXTERNAL_NETIF_SDIO || BRIDGE_DATA_FORWARDING_NETIF_SDIO

        config ESP_SDIO_CHECKSUM
            bool "SDIO checksum ENABLE/DISABLE"
            default n
            help
                ENABLE/DISABLE software SDIO checksum
    endmenu

    config EXAMPLE_HCI_UART_BAUDRATE
        int "UART Baudrate for HCI: Only applicable for ESP32-C3/ESP32-S3"
        range 115200 921600
        depends on IDF_TARGET_ESP32C3 || IDF_TARGET_ESP32S3 || IDF_TARGET_ESP32C2 || IDF_TARGET_ESP32C6
        depends on BT_CTRL_HCI_MODE_UART_H4
        default 921600
        help
            UART Baudrate for HCI over ESP32C2/C3/C6/S3. Please use standard baudrate.

    config ESP_DEFAULT_TASK_STACK_SIZE
        int "ESP-Hosted task stack size"
        default 4096
        help
            Default task size of ESP-Hosted tasks

    config ESP_DEFAULT_TASK_PRIO
        int "ESP-Hosted task priority"
        default 22
        help
            Default task priority of ESP-Hosted tasks

    config ESP_CACHE_MALLOC
        bool "Cache allocated memory like mempool - helps to reduce malloc calls"
        default y
        help
            Cache allocated memory - reduces number of malloc calls

    menu "Enable Debug logs"
        config ESP_SERIAL_DEBUG
            bool "Debug Serial driver data path"
            default n
            help
                Enable/disable debug prints in serial driver data path

        config ESP_WLAN_DEBUG
            bool "Debug Wlan driver data path"
            default n
            help
                Enable/disable debug prints in wlan driver data path

        config BRIDGE_BT_ENABLED
            bool "Enable Bluetooth driver"
            default n
            help
                Enable/disable debug prints in Bluetooth driver data path

        config ESP_BT_DEBUG
            depends on BRIDGE_BT_ENABLED
            bool "Debug Bluetooth driver data path"
            default n
            help
                Enable/disable debug prints in Bluetooth driver data path
    endmenu
endmenu
```

## components/wifi_prov_mgr/Kconfig
```kconfig
menu "Bridge Wi-Fi Provisioning Configuration"
    choice PROV_TRANSPORT
        bool "Provisioning Transport"
        default PROV_TRANSPORT_BLE
        help
            Wi-Fi provisioning component offers both, SoftAP and BLE transports. Choose any one.

        config PROV_TRANSPORT_BLE
            bool "BLE"
            select BT_ENABLED
            depends on !IDF_TARGET_ESP32S2
    endchoice

    choice PROV_SECURITY_VERSION
        bool "Protocomm security version"
        default PROV_SECURITY_VERSION_2
        help
            Wi-Fi provisioning component offers 3 security versions.
            The component offers a choice between security version 1 and 2.

        config PROV_SECURITY_VERSION_1
            bool "Security version 1"
            select ESP_PROTOCOMM_SUPPORT_SECURITY_VERSION_1

        config PROV_SECURITY_VERSION_2
            bool "Security version 2"
            select ESP_PROTOCOMM_SUPPORT_SECURITY_VERSION_2
    endchoice

    choice PROV_MODE
        bool "Security version 2 mode"
        depends on PROV_SECURITY_VERSION_2
        default PROV_SEC2_DEV_MODE

        config PROV_SEC2_DEV_MODE
            bool "Security version 2 development mode"
            depends on PROV_SECURITY_VERSION_2
            help
                This enables the development mode for security version 2.
                Please note that this mode is NOT recommended for production purpose.

        config PROV_SEC2_PROD_MODE
            bool "Security version 2 production mode"
            depends on PROV_SECURITY_VERSION_2
            help
                This enables the production mode for security version 2.
    endchoice

    config PROV_TRANSPORT
        int
        default 1 if PROV_TRANSPORT_BLE

    config PROV_RESET_PROVISIONED
        bool
        default n
        prompt "Reset provisioned status of the device"
        help
            This erases the NVS to reset provisioned status of the device on every reboot.
            Provisioned status is determined by the Wi-Fi STA configuration, saved on the NVS.

    config PROV_RESET_PROV_MGR_ON_FAILURE
        bool
        default y
        prompt "Reset provisioned credentials and state machine after session failure"
        help
            Enable reseting provisioned credentials and state machine after session failure.
            This will restart the provisioning service after retries are exhausted.

    config PROV_MGR_MAX_RETRY_CNT
        int
        default 5
        prompt "Max retries before reseting provisioning state machine"
        depends on PROV_RESET_PROV_MGR_ON_FAILURE
        help
            Set the Maximum retry to avoid reconnecting to an inexistent AP or if credentials
            are misconfigured. Provisioned credentials are erased and internal state machine
            is reset after this threshold is reached.

    config PROV_SHOW_QR
        bool "Show provisioning QR code"
        default y
        help
            Show the QR code for provisioning.

    config PROV_USING_BLUEDROID
        bool
        depends on (BT_BLUEDROID_ENABLED && (IDF_TARGET_ESP32C3 || IDF_TARGET_ESP32S3))
        select BT_BLE_42_FEATURES_SUPPORTED
        default y
        help
            This enables BLE 4.2 features for Bluedroid.
endmenu
```

## components/wifi_prov_mgr/Kconfig.projbuild
```kconfig
menu "Gateway Wi-Fi Provisoning Configuration"
    depends on GATEWAY_USE_WIFI_PROVISIONING_OVER_BLE

    choice ESP_GATEWAY_PROV_TRANSPORT
        bool "Provisioning Transport"
        default ESP_GATEWAY_PROV_TRANSPORT_BLE
        help
            Wi-Fi provisioning component offers both, SoftAP and BLE transports. Choose any one.

        config ESP_GATEWAY_PROV_TRANSPORT_BLE
            bool "BLE"
            select BT_ENABLED
            depends on !IDF_TARGET_ESP32S2
    endchoice

    choice ESP_GATEWAY_PROV_SECURITY_VERSION
        bool "Protocomm security version"
        default ESP_GATEWAY_PROV_SECURITY_VERSION_1
        help
            Wi-Fi provisioning component offers 3 security versions.
            The example offers a choice between security version 1 and 2.

        config ESP_GATEWAY_PROV_SECURITY_VERSION_1
            bool "Security version 1"
            select ESP_PROTOCOMM_SUPPORT_SECURITY_VERSION_1

        config ESP_GATEWAY_PROV_SECURITY_VERSION_2
            bool "Security version 2"
            select ESP_PROTOCOMM_SUPPORT_SECURITY_VERSION_2
    endchoice

    choice ESP_GATEWAY_PROV_MODE
        bool "Security version 2 mode"
        depends on ESP_GATEWAY_PROV_SECURITY_VERSION_2
        default ESP_GATEWAY_PROV_SEC2_DEV_MODE

        config ESP_GATEWAY_PROV_SEC2_DEV_MODE
            bool "Security version 2 development mode"
            depends on ESP_GATEWAY_PROV_SECURITY_VERSION_2
            help
                This enables the development mode for
                security version 2.
                Please note that this mode is NOT recommended for production purpose.

        config ESP_GATEWAY_PROV_SEC2_PROD_MODE
            bool "Security version 2 production mode"
            depends on ESP_GATEWAY_PROV_SECURITY_VERSION_2
            help
                This enables the production mode for
                security version 2.
    endchoice

    config ESP_GATEWAY_PROV_TRANSPORT
        int
        default 1 if ESP_GATEWAY_PROV_TRANSPORT_BLE

    config ESP_GATEWAY_RESET_PROVISIONED
        bool
        default n
        prompt "Reset provisioned status of the device"
        help
            This erases the NVS to reset provisioned status of the device on every reboot.
            Provisioned status is determined by the Wi-Fi STA configuration, saved on the NVS.

    config ESP_GATEWAY_RESET_PROV_MGR_ON_FAILURE
        bool
        default y
        prompt "Reset provisioned credentials and state machine after session failure"
        help
            Enable reseting provisioned credentials and state machine after session failure.
            This will restart the provisioning service after retries are exhausted.

    config ESP_GATEWAY_PROV_MGR_MAX_RETRY_CNT
        int
        default 5
        prompt "Max retries before reseting provisioning state machine"
        depends on ESP_GATEWAY_RESET_PROV_MGR_ON_FAILURE
        help
            Set the Maximum retry to avoid reconnecting to an inexistent AP or if credentials
            are misconfigured. Provisioned credentials are erased and internal state machine
            is reset after this threshold is reached.

    config ESP_GATEWAY_PROV_SHOW_QR
        bool "Show provisioning QR code"
        default y
        help
            Show the QR code for provisioning.

    config ESP_GATEWAY_PROV_USING_BLUEDROID
        bool
        depends on (BT_BLUEDROID_ENABLED && (IDF_TARGET_ESP32C3 || IDF_TARGET_ESP32S3))
        select BT_BLE_42_FEATURES_SUPPORTED
        default y
        help
            This enables BLE 4.2 features for Bluedroid.
endmenu
```
