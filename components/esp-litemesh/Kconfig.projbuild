## examples/wired_nic/sdkconfig.defaults.esp32p4
```kconfig
#
# TinyUSB Stack
#
CONFIG_TINYUSB=y
CONFIG_TINYUSB_DEBUG_LEVEL=0

#
# USB Network Class (RNDIS, ECM)
#
CONFIG_TINYUSB_NET_ENABLED=y
CONFIG_TINYUSB_RNDIS_VENDOR="Espressif Incorporated"
CONFIG_TINYUSB_NET_ECM=y

#
# USB Host CDC options
#
CONFIG_CDC_SEND_DTE_ACTIVE=n
CONFIG_CDC_BULK_OUT_URB_BUFFER_SIZE=1536
CONFIG_CDC_BULK_IN_URB_BUFFER_SIZE=1536
CONFIG_CDC_BULK_IN_URB_NUM=4
CONFIG_CDC_BULK_OUT_URB_NUM=4

CONFIG_TINYUSB_NET_MODE_ECM_RNDIS=y

CONFIG_TINYUSB_TASK_AFFINITY_CPU0=y
CONFIG_TINYUSB_INIT_IN_DEFAULT_TASK=y
CONFIG_TINYUSB_NET_MODE_NCM=y


CONFIG_ETH_USE_ESP32_EMAC=y
CONFIG_BRIDGE_ETH_PHY_IP101=y
CONFIG_BRIDGE_ETH_PHY_RTL8201=n
CONFIG_BRIDGE_ETH_PHY_LAN87XX=n
CONFIG_BRIDGE_ETH_PHY_DP83848=n
CONFIG_BRIDGE_ETH_PHY_KSZ80XX=n

CONFIG_BRIDGE_ETH_MDC_GPIO=31
CONFIG_BRIDGE_ETH_MDIO_GPIO=52
CONFIG_BRIDGE_ETH_PHY_RST_GPIO=51

CONFIG_BRIDGE_DATA_FORWARDING_NETIF_SPI=n

CONFIG_BRIDGE_DATA_FORWARDING_NETIF_USB=y
```

## examples/wireless_nic/sdkconfig.defaults.esp32s3
```kconfig
CONFIG_FREERTOS_UNICORE=y

#
# TinyUSB Stack
#
CONFIG_TINYUSB=y
CONFIG_TINYUSB_DEBUG_LEVEL=0

#
# USB Network Class (RNDIS, ECM)
#
CONFIG_TINYUSB_NET_ENABLED=y
CONFIG_TINYUSB_RNDIS_VENDOR="Espressif Incorporated"
CONFIG_TINYUSB_NET_ECM=y

#
# ESP32S3-Specific
#
CONFIG_ESP_DEFAULT_CPU_FREQ_MHZ_240=y
CONFIG_ESP_DEFAULT_CPU_FREQ_MHZ=240

CONFIG_USB_TASK_CORE_ID=1

#
# USB Host CDC options
#
CONFIG_CDC_SEND_DTE_ACTIVE=n
CONFIG_CDC_BULK_OUT_URB_BUFFER_SIZE=1536
CONFIG_CDC_BULK_IN_URB_BUFFER_SIZE=1536
CONFIG_CDC_BULK_IN_URB_NUM=4
CONFIG_CDC_BULK_OUT_URB_NUM=4

CONFIG_TINYUSB_NET_MODE_ECM_RNDIS=y

CONFIG_TINYUSB_TASK_AFFINITY_CPU0=y
CONFIG_TINYUSB_INIT_IN_DEFAULT_TASK=y
CONFIG_TINYUSB_NET_MODE_NCM=y
```

## main/Kconfig.projbuild
```kconfig
menu "Bridge Misc Configuration"
    depends on BRIDGE_ENABLE

    menu "Button Configuration"
        config GPIO_BUTTON_SW1
            default 16 if IDF_TARGET_ESP32   || IDF_TARGET_ESP32H2
            default 9  if IDF_TARGET_ESP32C3 || IDF_TARGET_ESP32C2
            default 38 if IDF_TARGET_ESP32S2 || IDF_TARGET_ESP32S3
            int "GPIO button of switch"
            help
                Set the GPIO button of switch.
    endmenu
endmenu
```
