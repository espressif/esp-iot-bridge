## optimize_sdkconfig/sdkconfig.defaults.esp32
```kconfig
#
# ESP32-specific
#
CONFIG_ESP32_ENABLE_COREDUMP=y
CONFIG_ESP32_ENABLE_COREDUMP_TO_FLASH=y
CONFIG_ESP32_DEFAULT_CPU_FREQ_240=y
CONFIG_ESP32_DEFAULT_CPU_FREQ_MHZ=240

#
# ESP32-specific
#
CONFIG_ESP32_WIFI_STATIC_RX_BUFFER_NUM=5
CONFIG_ESP32_WIFI_DYNAMIC_RX_BUFFER_NUM=16
CONFIG_ESP32_WIFI_DYNAMIC_TX_BUFFER_NUM=64
CONFIG_ESP32_WIFI_AMPDU_TX_ENABLED=y
CONFIG_ESP32_WIFI_TX_BA_WIN=32
CONFIG_ESP32_WIFI_AMPDU_RX_ENABLED=y
CONFIG_ESP32_WIFI_RX_BA_WIN=8

CONFIG_LWIP_TCP_SND_BUF_DEFAULT=5760
CONFIG_LWIP_TCP_WND_DEFAULT=5760
CONFIG_LWIP_TCP_RECVMBOX_SIZE=64
CONFIG_LWIP_UDP_RECVMBOX_SIZE=64
CONFIG_LWIP_TCPIP_RECVMBOX_SIZE=64

CONFIG_ESPTOOLPY_FLASHMODE_QIO=y
CONFIG_ESPTOOLPY_FLASHFREQ_40M=y
```

## optimize_sdkconfig/sdkconfig.defaults.esp32s3
```kconfig
CONFIG_FREERTOS_UNICORE=y

#
# TinyUSB Stack
#
CONFIG_TINYUSB=y
CONFIG_TINYUSB_DEBUG_LEVEL=0

#
# USB Network Class (RNDIS, ECM)
#
CONFIG_TINYUSB_NET_ENABLED=y
CONFIG_TINYUSB_RNDIS_VENDOR="Espressif Incorporated"
CONFIG_TINYUSB_NET_ECM=y

CONFIG_USB_TASK_CORE_ID=1

#
# USB Host CDC options
#
CONFIG_CDC_SEND_DTE_ACTIVE=n
CONFIG_CDC_BULK_OUT_URB_BUFFER_SIZE=1536
CONFIG_CDC_BULK_IN_URB_BUFFER_SIZE=1536
CONFIG_CDC_BULK_IN_URB_NUM=4
CONFIG_CDC_BULK_OUT_URB_NUM=4

#
# ESP32S3-specific
#
CONFIG_ESP32_WIFI_STATIC_RX_BUFFER_NUM=5
CONFIG_ESP32_WIFI_DYNAMIC_RX_BUFFER_NUM=16
CONFIG_ESP32_WIFI_DYNAMIC_TX_BUFFER_NUM=64
CONFIG_ESP32_WIFI_AMPDU_TX_ENABLED=y
CONFIG_ESP32_WIFI_TX_BA_WIN=32
CONFIG_ESP32_WIFI_AMPDU_RX_ENABLED=y
CONFIG_ESP32_WIFI_RX_BA_WIN=8

CONFIG_LWIP_TCP_SND_BUF_DEFAULT=5760
CONFIG_LWIP_TCP_WND_DEFAULT=5760
CONFIG_LWIP_TCP_RECVMBOX_SIZE=64
CONFIG_LWIP_UDP_RECVMBOX_SIZE=64
CONFIG_LWIP_TCPIP_RECVMBOX_SIZE=64

CONFIG_ESP32S3_DEFAULT_CPU_FREQ_240=y
CONFIG_ESP32S3_DEFAULT_CPU_FREQ_MHZ=240

CONFIG_ESPTOOLPY_FLASHMODE_QIO=y
CONFIG_ESPTOOLPY_FLASHFREQ_80M=y

CONFIG_ESP32S3_INSTRUCTION_CACHE_32KB=y
CONFIG_ESP32S3_INSTRUCTION_CACHE_LINE_32B=y
CONFIG_ESP32S3_INSTRUCTION_CACHE_WRAP=y
```

## sdkconfig.defaults
```kconfig
# Override some defaults in application project.

#
# Serial flasher config
#
CONFIG_ESPTOOLPY_FLASHSIZE_4MB=y
CONFIG_ESPTOOLPY_FLASHMODE_QIO=y
CONFIG_ESPTOOLPY_FLASHFREQ_80M=y
CONFIG_ESPTOOLPY_BAUD_921600B=y

#
# Partition Table
#
CONFIG_PARTITION_TABLE_OFFSET=0xc000
CONFIG_PARTITION_TABLE_CUSTOM=y
CONFIG_PARTITION_TABLE_CUSTOM_FILENAME="partitions.csv"


CONFIG_COMPILER_OPTIMIZATION_PERF=y


#
# HTTP Server
#
CONFIG_HTTPD_MAX_REQ_HDR_LEN=1024


#
# ESP32-specific
#
CONFIG_MEMMAP_SMP=y
CONFIG_ESP_SYSTEM_EVENT_TASK_STACK_SIZE=4096

CONFIG_ESP32_WIFI_STATIC_RX_BUFFER_NUM=16
CONFIG_ESP32_WIFI_DYNAMIC_RX_BUFFER_NUM=64
CONFIG_ESP32_WIFI_DYNAMIC_TX_BUFFER_NUM=64
CONFIG_ESP32_WIFI_AMPDU_TX_ENABLED=y
CONFIG_ESP32_WIFI_TX_BA_WIN=32
CONFIG_ESP32_WIFI_AMPDU_RX_ENABLED=y
CONFIG_ESP32_WIFI_RX_BA_WIN=32

CONFIG_FREERTOS_UNICORE=n
CONFIG_FREERTOS_HZ=1000

CONFIG_ESP_INT_WDT=n
CONFIG_ESP_TASK_WDT=n

CONFIG_LWIP_TCP_SND_BUF_DEFAULT=65534
CONFIG_LWIP_TCP_WND_DEFAULT=65534
CONFIG_LWIP_TCP_RECVMBOX_SIZE=64
CONFIG_LWIP_UDP_RECVMBOX_SIZE=64
CONFIG_LWIP_TCPIP_RECVMBOX_SIZE=64
CONFIG_LWIP_ETHARP_TRUST_IP_MAC=n
CONFIG_LWIP_IRAM_OPTIMIZATION=y

CONFIG_LWIP_L2_TO_L3_COPY=y
CONFIG_LWIP_IP_FORWARD=y
CONFIG_LWIP_IPV4_NAPT=y
CONFIG_LWIP_TCP_MSS=1460
CONFIG_LWIP_TCP_OVERSIZE_MSS=y

#
# HTTP Server
#
CONFIG_HTTPD_MAX_REQ_HDR_LEN=1024


CONFIG_GATEWAY_ETH_PHY_LAN8720=y
CONFIG_ETH_RMII_CLK_OUTPUT=y


# Override some defaults to enable PPP
CONFIG_LWIP_PPP_SUPPORT=y
CONFIG_LWIP_PPP_PAP_SUPPORT=y
CONFIG_LWIP_TCPIP_TASK_STACK_SIZE=4096
# Do not enable IPV6 in dte<->dce link local
CONFIG_LWIP_PPP_ENABLE_IPV6=n
# Disable legacy API
CONFIG_MODEM_LEGACY_API=n
# Enable NAPT
CONFIG_LWIP_IP_FORWARD=y
CONFIG_LWIP_IPV4_NAPT=y


CONFIG_ETH_DMA_BUFFER_SIZE=1600

CONFIG_ETH_SPI_ETHERNET_DM9051 = y
CONFIG_ETH_SPI_ETHERNET_KSZ8851SNL = y
CONFIG_ETH_SPI_ETHERNET_W5500 = y
```

## sdkconfig.defaults.esp32s2
```kconfig
#
# TinyUSB Stack
#
CONFIG_TINYUSB=y
CONFIG_TINYUSB_DEBUG_LEVEL=0

#
# USB Network Class (RNDIS, ECM)
#
CONFIG_TINYUSB_NET_ENABLED=y
CONFIG_TINYUSB_RNDIS_VENDOR="Espressif Incorporated"
CONFIG_TINYUSB_NET_RNDIS=y
```
